## main/Kconfig.projbuild
```kconfig
menu "RTSP Ethernet settings"

    config CAMERA_ETH_STATIC_IP
        string "Static IPv4 address"
        default "192.168.1.123"

    config CAMERA_ETH_STATIC_NETMASK
        string "IPv4 subnet mask"
        default "255.255.255.0"

    config CAMERA_ETH_STATIC_GATEWAY
        string "IPv4 gateway (0.0.0.0 for no gateway)"
        default "0.0.0.0"

    choice CAMERA_RTSP_RTP_TRANSPORT
        prompt "Recommended RTP transport"
        default CAMERA_RTSP_RTP_UDP
        help
            Sets the transport in the logged ffplay command. The RTSP
            server still uses the transport requested by the client in SETUP.

        config CAMERA_RTSP_RTP_UDP
            bool "UDP (lower latency on a clean LAN)"

        config CAMERA_RTSP_RTP_TCP
            bool "TCP (interleaved RTP)"
    endchoice

endmenu
```

## sdkconfig.defaults
```kconfig
CONFIG_SPIRAM=y
CONFIG_ESP_MAIN_TASK_AFFINITY_CPU0=y
CONFIG_CAMERA_OV5647=y
# CONFIG_CAMERA_OV5647_AUTO_DETECT_MIPI_INTERFACE_SENSOR is not set
CONFIG_CAMERA_OV5647_MIPI_RAW10_1920X1080_30FPS=y
```
